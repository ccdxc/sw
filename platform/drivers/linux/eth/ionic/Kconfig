## platform/drivers/linux/eth/ionic/Kconfig
```kconfig
# SPDX-License-Identifier: GPL-2.0
# Copyright(c) 2017 - 2019 Pensando Systems, Inc
#
# Pensando device configuration
#

config IONIC
	tristate "Pensando Ethernet NIC Support"
	depends on PCI && X86_64
	---help---
	  This enables the support for the Pensando Ethernet NIC.
```

## platform/drivers/linux/rdma/drv/ionic/Kconfig
```kconfig
# SPDX-License-Identifier: GPL-2.0 OR Linux-OpenIB
config INFINIBAND_IONIC_RDMA
	tristate "Pensando DSC RoCE/RDMA Driver"
	depends on NETDEVICES && ETHERNET && PCI && INET && CONFIG_64BIT
	---help---
	  This is a RoCE/RDMA driver for the Pensando Distributed Services
	  Card (DSC).

	  To learn more, visit our website at <https://pensando.io>.
```

## tools/buildrootdev/br-arm64-defconfig
```kconfig
BR2_aarch64=y
BR2_HOST_DIR="/buildroot-2016.11"
BR2_TOOLCHAIN_BUILDROOT_CXX=y
BR2_PACKAGE_HOST_GDB=y
BR2_ROOTFS_DEVICE_CREATION_STATIC=y
# BR2_TARGET_GENERIC_GETTY is not set
```
